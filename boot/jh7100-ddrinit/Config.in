## boot/jh7100-ddrinit/Config.in
```kconfig
config BR2_TARGET_JH7100_DDRINIT
	bool "jh7100-ddrinit"
	depends on BR2_riscv
	depends on BR2_HOSTARCH = "x86_64" # host-riscv64-elf-toolchain
	help
	  This package builds the DDRinit firmware used on the JH7100
	  platform.

	  https://github.com/starfive-tech/jh7100_ddrinit
```

## boot/jh7100-secondboot/Config.in
```kconfig
config BR2_TARGET_JH7100_SECONDBOOT
	bool "JH7100-secondboot"
	depends on BR2_riscv
	depends on BR2_HOSTARCH = "x86_64" # host-riscv64-elf-toolchain
	help
	  This package builds the SecondBoot firmware used on the
	  JH7100 platform.

	  https://github.com/starfive-tech/beagle_secondBoot
```

## configs/beaglev_defconfig
```kconfig
BR2_riscv=y
BR2_riscv_custom=y
BR2_RISCV_ISA_CUSTOM_RVM=y
BR2_RISCV_ISA_CUSTOM_RVF=y
BR2_RISCV_ISA_CUSTOM_RVD=y
BR2_RISCV_ISA_CUSTOM_RVC=y
BR2_PACKAGE_HOST_LINUX_HEADERS_CUSTOM_5_13=y
BR2_ROOTFS_POST_BUILD_SCRIPT="board/beaglev/post-build.sh"
BR2_ROOTFS_POST_IMAGE_SCRIPT="support/scripts/genimage.sh"
BR2_ROOTFS_POST_SCRIPT_ARGS="-c board/beaglev/genimage.cfg"
BR2_LINUX_KERNEL=y
BR2_LINUX_KERNEL_CUSTOM_TARBALL=y
# tag buildroot-20210609 of the 5.13 branch (esmil_starlight)
BR2_LINUX_KERNEL_CUSTOM_TARBALL_LOCATION="$(call github,starfive-tech,linux,e1a6584d2c9cbdeba95d3a0207863e97e64d104e)/linux-e1a6584d2c9cbdeba95d3a0207863e97e64d104e.tar.gz"
BR2_LINUX_KERNEL_DEFCONFIG="visionfive"
BR2_LINUX_KERNEL_DTS_SUPPORT=y
BR2_LINUX_KERNEL_INTREE_DTS_NAME="starfive/jh7100-starfive-visionfive-v1"
BR2_LINUX_KERNEL_INSTALL_TARGET=y
BR2_LINUX_KERNEL_NEEDS_HOST_OPENSSL=y
BR2_TARGET_ROOTFS_EXT2=y
BR2_TARGET_ROOTFS_EXT2_4=y
# BR2_TARGET_ROOTFS_TAR is not set
BR2_TARGET_JH7100_DDRINIT=y
BR2_TARGET_JH7100_SECONDBOOT=y
BR2_TARGET_OPENSBI=y
BR2_TARGET_OPENSBI_CUSTOM_TARBALL=y
# upstream opensbi master branch
BR2_TARGET_OPENSBI_CUSTOM_TARBALL_LOCATION="$(call github,starfive-tech,opensbi,2acaad3729d20761480cd1f355f75fc1e5c18c8b)/opensbi-2acaad3729d20761480cd1f355f75fc1e5c18c8b.tar.gz"
BR2_TARGET_OPENSBI_PLAT="generic"
# BR2_TARGET_OPENSBI_INSTALL_DYNAMIC_IMG is not set
# BR2_TARGET_OPENSBI_INSTALL_JUMP_IMG is not set
BR2_TARGET_OPENSBI_UBOOT_PAYLOAD=y
BR2_TARGET_OPENSBI_FW_FDT_PATH=y
BR2_TARGET_UBOOT=y
BR2_TARGET_UBOOT_BUILD_SYSTEM_KCONFIG=y
BR2_TARGET_UBOOT_CUSTOM_TARBALL=y
# HEAD of the starfive-tech:Fedora_VIC_7100_2021.04 branch
BR2_TARGET_UBOOT_CUSTOM_TARBALL_LOCATION="$(call github,starfive-tech,u-boot,e095428f8aaef8b317c352e42972111e0d44b75d)/uboot-e095428f8aaef8b317c352e42972111e0d44b75d.tar.gz"
BR2_TARGET_UBOOT_BOARD_DEFCONFIG="starfive_jh7100_visionfive_smode"
BR2_PACKAGE_HOST_GENIMAGE=y
BR2_PACKAGE_HOST_JH71XX_TOOLS=y
```

## configs/hifive_unmatched_defconfig
```kconfig
# Architecture
BR2_riscv=y
BR2_riscv_custom=y
BR2_RISCV_ISA_CUSTOM_RVM=y
BR2_RISCV_ISA_CUSTOM_RVF=y
BR2_RISCV_ISA_CUSTOM_RVD=y
BR2_RISCV_ISA_CUSTOM_RVC=y
BR2_RISCV_64=y
BR2_RISCV_ABI_LP64D=y

# System
BR2_SYSTEM_DHCP="eth0"
BR2_TARGET_GENERIC_GETTY=y
BR2_TARGET_GENERIC_GETTY_PORT="ttySIF0"
BR2_ROOTFS_POST_BUILD_SCRIPT="board/sifive/hifive-unmatched/post-build.sh"
BR2_ROOTFS_POST_IMAGE_SCRIPT="support/scripts/genimage.sh"
BR2_ROOTFS_POST_SCRIPT_ARGS="-c board/sifive/hifive-unmatched/genimage_sdcard.cfg"

# Filesystem
BR2_TARGET_ROOTFS_CPIO=y
BR2_TARGET_ROOTFS_EXT2=y
BR2_TARGET_ROOTFS_EXT2_4=y

# Linux headers same as kernel, a 5.10 series
BR2_PACKAGE_HOST_LINUX_HEADERS_CUSTOM_5_13=y

# Kernel
BR2_LINUX_KERNEL=y
BR2_LINUX_KERNEL_CUSTOM_VERSION=y
BR2_LINUX_KERNEL_CUSTOM_VERSION_VALUE="5.13.9"
BR2_LINUX_KERNEL_USE_ARCH_DEFAULT_CONFIG=y
BR2_LINUX_KERNEL_CONFIG_FRAGMENT_FILES="board/sifive/hifive-unmatched/linux.config.fragment"
BR2_LINUX_KERNEL_IMAGE=y
BR2_LINUX_KERNEL_PATCH="board/sifive/hifive-unmatched/5.13.9/"
BR2_LINUX_KERNEL_DTS_SUPPORT=y
BR2_LINUX_KERNEL_INTREE_DTS_NAME="sifive/hifive-unmatched-a00"
BR2_LINUX_KERNEL_INSTALL_TARGET=y

# Bootloader
BR2_TARGET_OPENSBI=y
BR2_TARGET_OPENSBI_PLAT="generic"
BR2_TARGET_UBOOT=y
BR2_TARGET_UBOOT_CUSTOM_VERSION=y
BR2_TARGET_UBOOT_CUSTOM_VERSION_VALUE="2021.07"
BR2_TARGET_UBOOT_PATCH="board/sifive/hifive-unmatched/uboot/"
BR2_TARGET_UBOOT_BUILD_SYSTEM_KCONFIG=y
BR2_TARGET_UBOOT_BOARD_DEFCONFIG="sifive_unmatched"
BR2_TARGET_UBOOT_NEEDS_DTC=y
BR2_TARGET_UBOOT_NEEDS_PYTHON3=y
BR2_TARGET_UBOOT_NEEDS_PYLIBFDT=y
BR2_TARGET_UBOOT_NEEDS_OPENSSL=y
BR2_TARGET_UBOOT_FORMAT_DTB_IMG=y
BR2_TARGET_UBOOT_FORMAT_DTB_BIN=y
BR2_TARGET_UBOOT_FORMAT_CUSTOM=y
BR2_TARGET_UBOOT_FORMAT_CUSTOM_NAME="u-boot.itb"
BR2_TARGET_UBOOT_NEEDS_OPENSBI=y
BR2_TARGET_UBOOT_SPL=y

# Host tools
BR2_PACKAGE_HOST_GENIMAGE=y
BR2_PACKAGE_HOST_UBOOT_TOOLS=y
BR2_PACKAGE_HOST_UBOOT_TOOLS_BOOT_SCRIPT=y
BR2_PACKAGE_HOST_UBOOT_TOOLS_BOOT_SCRIPT_SOURCE="board/sifive/hifive-unmatched/boot.cmd"
```

## configs/milkv_duo_musl_defconfig
```kconfig
BR2_riscv=y
BR2_TOOLCHAIN_EXTERNAL=y
BR2_TOOLCHAIN_EXTERNAL_CUSTOM=y
BR2_TOOLCHAIN_EXTERNAL_DOWNLOAD=y
BR2_TOOLCHAIN_EXTERNAL_URL="https://sophon-file.sophon.cn/sophon-prod-s3/drive/23/03/07/16/host-tools.tar.gz"
BR2_TOOLCHAIN_EXTERNAL_REL_BIN_PATH="gcc/riscv64-linux-musl-x86_64/bin"
BR2_TOOLCHAIN_EXTERNAL_CUSTOM_PREFIX="riscv64-unknown-linux-musl"
BR2_TOOLCHAIN_EXTERNAL_GCC_10=y
BR2_TOOLCHAIN_EXTERNAL_HEADERS_5_10=y
BR2_TOOLCHAIN_EXTERNAL_CUSTOM_MUSL=y
BR2_TOOLCHAIN_EXTERNAL_CXX=y
BR2_TOOLCHAIN_EXTERNAL_OPENMP=y
BR2_TARGET_LDFLAGS="-mcpu=c906fdv -march=rv64imafdcv0p7xthead -mcmodel=medany -mabi=lp64d"
BR2_CPAN_MIRROR="http://cpan.metacpan.org"
BR2_TARGET_GENERIC_HOSTNAME="milkv"
BR2_TARGET_GENERIC_ISSUE="Welcome to Milk-V"
BR2_TARGET_GENERIC_ROOT_PASSWD="milkv"
BR2_ROOTFS_OVERLAY="board/milkv/duo/overlay"
BR2_PACKAGE_GDB=y
BR2_PACKAGE_STRACE=y
BR2_PACKAGE_E2FSPROGS=y
BR2_PACKAGE_E2FSPROGS_RESIZE2FS=y
BR2_PACKAGE_EVTEST=y
BR2_PACKAGE_JSON_C=y
BR2_PACKAGE_DNSMASQ=y
BR2_PACKAGE_DROPBEAR=y
BR2_PACKAGE_WPA_SUPPLICANT=y
BR2_PACKAGE_WPA_SUPPLICANT_CLI=y
BR2_PACKAGE_WPA_SUPPLICANT_WPA_CLIENT_SO=y
BR2_PACKAGE_KMOD=y
BR2_PACKAGE_UTIL_LINUX_UUIDD=y
BR2_TARGET_ROOTFS_EXT2=y
BR2_TARGET_ROOTFS_EXT2_4=y
BR2_TARGET_ROOTFS_EXT2_SIZE="200M"
BR2_TARGET_ROOTFS_TAR_XZ=y
BR2_PACKAGE_HOST_GENIMAGE=y
```

## configs/sophpi_duo_defconfig
```kconfig
BR2_riscv=y
BR2_PER_PACKAGE_DIRECTORIES=y
BR2_TOOLCHAIN_EXTERNAL=y
BR2_TOOLCHAIN_EXTERNAL_CUSTOM_PREFIX="riscv64-unknown-linux-musl"
BR2_TOOLCHAIN_EXTERNAL_HEADERS_5_10=y
BR2_TOOLCHAIN_EXTERNAL_CUSTOM_MUSL=y
BR2_TOOLCHAIN_EXTERNAL_CXX=y
# BR2_TARGET_LDFLAGS="-mcpu=c906fdv -march=rv64imafdcv0p7xthead -mcmodel=medany -mabi=lp64d"
BR2_TARGET_GENERIC_HOSTNAME="milkv-duo"
BR2_TARGET_GENERIC_ISSUE="Welcome to Milk-V Duo 256M"
BR2_TARGET_GENERIC_ROOT_PASSWD="milkv"
BR2_ROOTFS_OVERLAY="board/sophpi/sophpi_duo/overlay"
BR2_PACKAGE_TREE=y
BR2_PACKAGE_PYTHON3=y
BR2_PACKAGE_PYTHON3_PY_PYC=y
BR2_PACKAGE_PYTHON_EVDEV=y
BR2_PACKAGE_PYTHON_FREETYPE=y
BR2_PACKAGE_PYTHON_LXML=y
BR2_PACKAGE_PYTHON_MODBUS_TK=y
BR2_PACKAGE_PYTHON_PILLOW=y
BR2_PACKAGE_PYTHON_PIP=y
BR2_PACKAGE_PYTHON_PSUTIL=y
BR2_PACKAGE_PYTHON_SMBUS_CFFI=y
BR2_PACKAGE_PYTHON_SPIDEV=y
BR2_PACKAGE_JSON_C=y
BR2_PACKAGE_DHCPCD=y
BR2_PACKAGE_DNSMASQ=y
BR2_PACKAGE_DROPBEAR=y
BR2_PACKAGE_IPERF3=y
BR2_PACKAGE_NTP=y
BR2_PACKAGE_NTP_NTPDATE=y
BR2_PACKAGE_NTP_NTPTIME=y
BR2_PACKAGE_WPA_SUPPLICANT=y
BR2_PACKAGE_WPA_SUPPLICANT_CLI=y
BR2_PACKAGE_WPA_SUPPLICANT_WPA_CLIENT_SO=y
BR2_PACKAGE_FILE=y
BR2_PACKAGE_HTOP=y
BR2_PACKAGE_KMOD=y
BR2_PACKAGE_UTIL_LINUX_UUIDD=y
BR2_PACKAGE_NANO=y
BR2_TARGET_ROOTFS_EXT2=y
BR2_TARGET_ROOTFS_EXT2_4=y
BR2_TARGET_ROOTFS_EXT2_SIZE="200M"
BR2_TARGET_ROOTFS_TAR_XZ=y
```

## package/go-ci/Config.in
```kconfig
config BR2_PACKAGE_GO_CI
	bool "go ci test"
	default y
	depends on BR2_RISCV_64
	help
	  base on buildroot GO CI test

comment "go ci need host go bootstrap supports"
	depends on !BR2_RISCV_64

config BR2_PACKAGE_PRE_GO
	bool
	default y
	depends on BR2_PACKAGE_GO_CI
	help
	  base on buildroot GO CI test

config BR2_PACKAGE_GOBOOTSTRAP_TAR
	bool
	default y
	depends on BR2_PACKAGE_GO_CI
	depends on BR2_PACKAGE_HOST_GO_BOOTSTRAP_ARCH_SUPPORTS
	help
	  base on buildroot GO CI test
```

## package/go/Config.in
```kconfig
config BR2_PACKAGE_GO
	bool "go support"
	default y
	depends on BR2_PACKAGE_HOST_GO_BOOTSTRAP_ARCH_SUPPORTS
```

## package/litmus-test/Config.in
```kconfig
config BR2_PACKAGE_LITMUS_TEST
	bool "litmus test"
	depends on BR2_PACKAGE_HOST_HERDTOOLS7
	help
	  The tests can also be used for memroy order test.

	  https://github.com/litmus-tests/litmus-tests-riscv

comment " litmus test needs herdtools7"
	depends on  !BR2_PACKAGE_HOST_HERDTOOLS7

config BR2_PACKAGE_KLITMUS_TEST
	bool "klitmus test"
	depends on BR2_PACKAGE_HOST_HERDTOOLS7
	help
	  The tests can also be used for kernel memroy order test.

comment " litmus test needs herdtools7"
	depends on  !BR2_PACKAGE_HOST_HERDTOOLS7
```

## package/ocaml-find/Config.in.host
```kconfig
config BR2_PACKAGE_HOST_OCAML_FIND
	bool "host ocaml-find"
	depends on BR2_PACKAGE_HOST_OCAML
	help
	  Ocaml Language find Package.

	  https://github.com/ocaml/ocamlfind

comment "ocaml-find needs ocaml"
	depends on  !BR2_PACKAGE_HOST_OCAML
```

## package/ocamlgraph/Config.in.host
```kconfig
config BR2_PACKAGE_HOST_OCAMLGRAPH
	bool "host ocamlgraph"
	depends on BR2_PACKAGE_HOST_OCAML
	help
	  Ocaml Language Ocamlgraph Package.

	  http://ocamlgraph.lri.fr/index.en.html
	  https://github.com/backtracking/ocamlgraph

comment "ocamlgraph needs ocaml"
	depends on  !BR2_PACKAGE_HOST_OCAML
```

## package/opam/Config.in.host
```kconfig
config BR2_PACKAGE_HOST_OPAM
	bool "host opam"
	depends on BR2_PACKAGE_HOST_OCAML
	help
	  Ocaml Language opam Package.

	  https://github.com/ocaml/opam

comment "opam needs ocaml"
	depends on  !BR2_PACKAGE_HOST_OCAML
```
